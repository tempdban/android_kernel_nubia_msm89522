## drivers/platform/nubia/Kconfig
```kconfig
# Gree configuration options

config MACH_NUBIA
	bool "NUBIA device"
	depends on ARCH_MSM
	help
	  Support for Nubia products

config MACH_NUBIA_MSM8916
	bool "NUBIA MSM8916"
	depends on ARCH_MSM8916
	select MACH_NUBIA
	help
	  Support for MSM8916 Nubia variants

menu "Gree board selection"

	config MACH_NUBIA_NX523J
		bool "NUBIA_NX523J board"
		select MACH_NUBIA_MSM8916
		help
		  Support for Nubia NX523J variant
		  
	config MACH_NUBIA_NX529J
		bool "NUBIA_NX529J board"
		select MACH_NUBIA_MSM8916
		help
		  Support for Nubia NX529J variant

endmenu
```
